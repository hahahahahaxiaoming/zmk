## app/boards/snail60/Kconfig.snail60
```kconfig
# Copyright (c) 2021 Nick Winans
# SPDX-License-Identifier: Apache-2.0

config BOARD_SNAIL60
    select SOC_NRF52840_QIAA
    select SOC_DCDC_NRF52X
    imply RETAINED_MEM
    imply RETENTION
    imply RETENTION_BOOT_MODE
```

## app/boards/snail60/snail60_defconfig
```kconfig
# Copyright (c) 2021 Nick Winans
# SPDX-License-Identifier: MIT

# Enable MPU
CONFIG_ARM_MPU=y

CONFIG_PINCTRL=y

# enable GPIO
CONFIG_GPIO=y

# Build configurations
CONFIG_USE_DT_CODE_PARTITION=y
CONFIG_BUILD_OUTPUT_UF2=y

# Flash configuration
CONFIG_MPU_ALLOW_FLASH_WRITE=y
CONFIG_NVS=y
CONFIG_SETTINGS_NVS=y
CONFIG_FLASH=y
CONFIG_FLASH_PAGE_LAYOUT=y
CONFIG_FLASH_MAP=y
CONFIG_CLOCK_CONTROL_NRF=y
CONFIG_CLOCK_CONTROL_NRF_K32SRC_RC=n

# Enable both USB and BLE
CONFIG_ZMK_USB=y
CONFIG_ZMK_BLE=y
CONFIG_USB_HID_POLL_INTERVAL_MS=1
CONFIG_USB_DEVICE_STACK=y
CONFIG_USB_CDC_ACM=y
CONFIG_SERIAL=y
CONFIG_UART_INTERRUPT_DRIVEN=y
CONFIG_UART_LINE_CTRL=y

# 设置蓝牙显示的名称
CONFIG_ZMK_KEYBOARD_NAME="Mjt Keyboard"

# 启用 nRF USB 驱动 (对应 USB_NRFX default y)
CONFIG_USB_NRFX=y

# 启用蓝牙控制器 (对应 BT_CTLR default BT)
CONFIG_BT_CTLR=y

# 开启 ZMK Studio 支持
CONFIG_ZMK_STUDIO=y
CONFIG_ZMK_STUDIO_LOCKING=n
CONFIG_ZMK_STUDIO_LOCK_ON_DISCONNECT=n

# 启用接收来自已连接主机的 HID/LED 指示灯状态信息
CONFIG_ZMK_HID_INDICATORS=y
# 启用全键无冲。这可能导致键盘无法支持某些BIOS/UEFI版本。
CONFIG_ZMK_HID_REPORT_TYPE_NKRO=y

# 必须开启 PWM 驱动，亮度调节才有效
CONFIG_PWM=y
# 启用背光功能
CONFIG_ZMK_BACKLIGHT=y
# 设置初始亮度为 10%
CONFIG_ZMK_BACKLIGHT_BRT_START=10
# 每次调亮/调暗的幅度（默认是 10%）
CONFIG_ZMK_BACKLIGHT_BRT_STEP=10
# 默认开机点亮背光
CONFIG_ZMK_BACKLIGHT_ON_START=y
# 开启闲置自动关灯
CONFIG_ZMK_BACKLIGHT_AUTO_OFF_IDLE=y
CONFIG_ZMK_BACKLIGHT_IDLE_OFF_BATTERY_ONLY=y
# 设置闲置 5 分钟后关灯 (5 * 60 * 1000 = 300000)
# CONFIG_ZMK_BACKLIGHT_IDLE_TIMEOUT=300000

# 启用软关机功能
CONFIG_ZMK_PM_SOFT_OFF=y

# 开启深度休眠，默认是不打开的
CONFIG_ZMK_SLEEP=y
# 2小时sleep不写这一行，默认就是 15 分钟
CONFIG_ZMK_IDLE_SLEEP_TIMEOUT=7200000
```
